## boards/adafruit/feather_v2/Kconfig.feather_v2
```kconfig
# Copyright (c) 2023 Espressif Systems (Shanghai) Co., Ltd.
# SPDX-License-Identifier: Apache-2.0

config BOARD_FEATHER_V2
	select SOC_ESP32_PICO_V3_02
	select SOC_ESP32_PROCPU if BOARD_FEATHER_V2_ESP32_PROCPU
	select SOC_ESP32_APPCPU if BOARD_FEATHER_V2_ESP32_APPCPU
```

## boards/shields/adafruit_2900_oled/Kconfig.shield
```kconfig
# Copyright (c) 2019 Linaro Limited
# SPDX-License-Identifier: Apache-2.0

config SHIELD_ADAFRUIT_2900_OLED
	def_bool $(shields_list_contains,shield_adafruit_2900_oled)
```

## boards/shields/adafruit_3632_joy/Kconfig.defconfig
```kconfig
# Copyright (c) 2024 Trada AS
# SPDX-License-Identifier: Apache-2.0

if SHIELD_ADAFRUIT_3632_JOY

config JOYWING_X_OFFSET
	int "Joystick X axis offset"
	default 0
	help
	  X-axis offset correction

config JOYWING_Y_OFFSET
	int "Joystick Y axis offset"
	default 0
	help
	  Y-axis offset correction

endif # SHIELD_ADAFRUIT_3632_JOY
```

## boards/shields/adafruit_3632_joy/Kconfig.shield
```kconfig
# Copyright (c) 2024 Trada AS
# SPDX-License-Identifier: Apache-2.0

config SHIELD_ADAFRUIT_3632_JOY
	def_bool $(shields_list_contains,shield_adafruit_3632_joy)
```

## boards/shields/adafruit_4565_9dof_imu/Kconfig.shield
```kconfig
# Copyright (c) 2019 Linaro Limited
# SPDX-License-Identifier: Apache-2.0

config SHIELD_ADAFRUIT_4565_9DOF_IMU
	def_bool $(shields_list_contains,shield_adafruit_4565_9dof_imu)
	
```

## drivers/sensor/adafruit/seesaw/Kconfig
```kconfig
# Copyright (c) 2024 Trada AS
# SPDX-License-Identifier: Apache-2.0

menuconfig SEESAW
	bool "Adafruit Seesaw"
	default y
	depends on DT_HAS_ADAFRUIT_SEESAW_ENABLED
	select I2C
	help
	  Enable driver for the Adafruit Seesaw controllers
```

## dts/bindings/sensor/adafruit,seesaw.yaml
```yaml
# Copyright (c) 2018 Analog Devices Inc.
# SPDX-License-Identifier: Apache-2.0

description: Adafruit SeeSaw board interface

compatible: "adafruit,seesaw"

include: [sensor-device.yaml, i2c-device.yaml]
```
